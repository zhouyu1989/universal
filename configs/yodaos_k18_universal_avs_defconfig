## configs/yodaos_k18_universal_avs_defconfig
```kconfig
CONFIG_TARGET_leo=y
CONFIG_TARGET_leo_k18_universal=y
CONFIG_TARGET_leo_k18_universal_LEO_K18_UNIVERSAL=y
CONFIG_DEVEL=y
CONFIG_TOOLCHAINOPTS=y
CONFIG_BINARY_FOLDER="$(TOPDIR)/bin/yodaos-k18-universal-avs"
CONFIG_BLUETOOTH_USE_BSA_AMPAK=y
CONFIG_BOARD_LED_NUMS=12
CONFIG_BT_SERVICE_IPC_BY_FLORA=y
CONFIG_EXTERNAL_KERNEL_CONFIG=y
CONFIG_EXTERNAL_KERNEL_TREE="$(TOPDIR)/../kernel/k18/4.4"
CONFIG_EXTERNAL_UBOOT_TREE="$(TOPDIR)/../uboot/k18/uboot"
CONFIG_GET_LIBAV_COMMON_AV_SUPPORT=y
CONFIG_GLIBC_USE_VERSION_2_22=y
CONFIG_GLIBC_VERSION="2.22"
CONFIG_GLIBC_VERSION_2_22=y
CONFIG_GNUTLS_ALPN=y
CONFIG_GNUTLS_ANON=y
CONFIG_GNUTLS_DTLS_SRTP=y
CONFIG_GNUTLS_HEARTBEAT=y
CONFIG_GNUTLS_OCSP=y
CONFIG_GNUTLS_PSK=y
CONFIG_GST1_LIBAV_DECODER_aac=y
CONFIG_GST1_LIBAV_DECODER_ac3=y
CONFIG_GST1_LIBAV_DECODER_atrac3=y
CONFIG_GST1_LIBAV_DECODER_h264=y
CONFIG_GST1_LIBAV_DECODER_jpegls=y
CONFIG_GST1_LIBAV_DECODER_mp3=y
CONFIG_GST1_LIBAV_DECODER_mpeg1video=y
CONFIG_GST1_LIBAV_DECODER_mpeg2video=y
CONFIG_GST1_LIBAV_DECODER_mpeg4=y
CONFIG_GST1_LIBAV_DECODER_mpeg4aac=y
CONFIG_GST1_LIBAV_DECODER_mpegvideo=y
CONFIG_GST1_LIBAV_DECODER_pcm_s16be=y
CONFIG_GST1_LIBAV_DECODER_pcm_s16le=y
CONFIG_GST1_LIBAV_DECODER_png=y
CONFIG_GST1_LIBAV_DECODER_vorbis=y
CONFIG_GST1_LIBAV_DECODER_wmav1=y
CONFIG_GST1_LIBAV_DECODER_wmav2=y
CONFIG_GST1_LIBAV_DECODER_zlib=y
CONFIG_GST1_LIBAV_DEMUXER_ac3=y
CONFIG_GST1_LIBAV_DEMUXER_h264=y
CONFIG_GST1_LIBAV_DEMUXER_mp3=y
CONFIG_GST1_LIBAV_DEMUXER_mpegvideo=y
CONFIG_GST1_LIBAV_DEMUXER_ogg=y
CONFIG_GST1_LIBAV_IPV6=y
CONFIG_GST1_LIBAV_PARSER_aac=y
CONFIG_GST1_LIBAV_PARSER_ac3=y
CONFIG_GST1_LIBAV_PARSER_h264=y
CONFIG_GST1_LIBAV_PARSER_mpeg4video=y
CONFIG_GST1_LIBAV_PARSER_mpegaudio=y
CONFIG_GST1_LIBAV_PARSER_mpegvideo=y
CONFIG_GST1_LIBAV_PATENTED=y
CONFIG_KERNEL_ARM_PMU=y
CONFIG_KERNEL_BLK_CGROUP=y
CONFIG_KERNEL_CGROUPS=y
CONFIG_KERNEL_CGROUP_DEVICE=y
CONFIG_KERNEL_CGROUP_FREEZER=y
CONFIG_KERNEL_CGROUP_PERF=y
CONFIG_KERNEL_CGROUP_PIDS=y
CONFIG_KERNEL_FREEZER=y
CONFIG_KERNEL_IP_PNP=y
CONFIG_KERNEL_IP_PNP_DHCP=y
CONFIG_KERNEL_NETPRIO_CGROUP=y
CONFIG_KERNEL_NET_CLS_CGROUP=y
CONFIG_KERNEL_NFS_FS=y
CONFIG_KERNEL_NFS_V2=y
CONFIG_KERNEL_NFS_V3=y
CONFIG_KERNEL_PERF_EVENTS=y
CONFIG_KERNEL_PROC_PAGE_MONITOR=y
CONFIG_KERNEL_PROFILING=y
CONFIG_KERNEL_ROOT_NFS=y
CONFIG_LED_HAL_VSP=y
CONFIG_LEO_SD_ROOTFS_PARTSIZE="65m"
CONFIG_LIBC="glibc"
CONFIG_LIBC_USE_GLIBC=y
# CONFIG_LIBC_USE_MUSL is not set
CONFIG_LIBC_VERSION="2.22"
CONFIG_MIC_ARRAY_HAL_VSP=y
CONFIG_PACKAGE_AFEDataProxy=y
CONFIG_PACKAGE_AMPAK_6236=y
CONFIG_PACKAGE_AMPAK_6236_BY_BSA=y
CONFIG_PACKAGE_RokidAlexaClient=y
CONFIG_PACKAGE_RokidAlexaServer=y
CONFIG_PACKAGE_SDL2=y
CONFIG_PACKAGE_adbd=y
CONFIG_PACKAGE_ai-libs-common=y
# CONFIG_PACKAGE_aicore is not set
CONFIG_PACKAGE_alab-libs=y
CONFIG_PACKAGE_aliyunloglite=y
CONFIG_PACKAGE_alsa-utils=y
CONFIG_PACKAGE_android-fw-native=y
CONFIG_PACKAGE_android-hardware=y
CONFIG_PACKAGE_android-kernel-headers=y
CONFIG_PACKAGE_android-system-core=y
# CONFIG_PACKAGE_appmedia is not set
CONFIG_PACKAGE_avs-sdk=y
CONFIG_PACKAGE_bcmdhd_fw=y
CONFIG_PACKAGE_blis=y
CONFIG_PACKAGE_bluetooth_service=y
CONFIG_PACKAGE_bsa_server=y
CONFIG_PACKAGE_cJSON=y
CONFIG_PACKAGE_dbus-cpp=y
CONFIG_PACKAGE_dbus-utils=y
CONFIG_PACKAGE_dhcpcd=y
# CONFIG_PACKAGE_eesen-master is not set
CONFIG_PACKAGE_eq_ctrl=y
CONFIG_PACKAGE_factory=y
CONFIG_PACKAGE_fftw3f=y
CONFIG_PACKAGE_flora=y
CONFIG_PACKAGE_flora-dispatcher=y
CONFIG_PACKAGE_gst1-libav=y
CONFIG_PACKAGE_gst1-mod-adpcmdec=y
CONFIG_PACKAGE_gst1-mod-adpcmenc=y
CONFIG_PACKAGE_gst1-mod-aiff=y
CONFIG_PACKAGE_gst1-mod-alaw=y
CONFIG_PACKAGE_gst1-mod-alpha=y
CONFIG_PACKAGE_gst1-mod-alphacolor=y
CONFIG_PACKAGE_gst1-mod-alsa=y
CONFIG_PACKAGE_gst1-mod-apetag=y
CONFIG_PACKAGE_gst1-mod-app=y
CONFIG_PACKAGE_gst1-mod-asf=y
CONFIG_PACKAGE_gst1-mod-asfmux=y
CONFIG_PACKAGE_gst1-mod-audioconvert=y
CONFIG_PACKAGE_gst1-mod-audiofx=y
CONFIG_PACKAGE_gst1-mod-audioparsers=y
CONFIG_PACKAGE_gst1-mod-audiorate=y
CONFIG_PACKAGE_gst1-mod-audioresample=y
CONFIG_PACKAGE_gst1-mod-audiotestsrc=y
CONFIG_PACKAGE_gst1-mod-auparse=y
CONFIG_PACKAGE_gst1-mod-autoconvert=y
CONFIG_PACKAGE_gst1-mod-autodetect=y
CONFIG_PACKAGE_gst1-mod-avi=y
CONFIG_PACKAGE_gst1-mod-bayer=y
CONFIG_PACKAGE_gst1-mod-camerabin=y
CONFIG_PACKAGE_gst1-mod-cutter=y
CONFIG_PACKAGE_gst1-mod-debug=y
CONFIG_PACKAGE_gst1-mod-debugutilsbad=y
CONFIG_PACKAGE_gst1-mod-deinterlace=y
CONFIG_PACKAGE_gst1-mod-dtmf=y
CONFIG_PACKAGE_gst1-mod-dvdspu=y
CONFIG_PACKAGE_gst1-mod-effectv=y
CONFIG_PACKAGE_gst1-mod-equalizer=y
CONFIG_PACKAGE_gst1-mod-fbdevsink=y
CONFIG_PACKAGE_gst1-mod-festival=y
CONFIG_PACKAGE_gst1-mod-flv=y
CONFIG_PACKAGE_gst1-mod-flxdec=y
CONFIG_PACKAGE_gst1-mod-frei0r=y
CONFIG_PACKAGE_gst1-mod-gio=y
CONFIG_PACKAGE_gst1-mod-goom=y
CONFIG_PACKAGE_gst1-mod-goom2k1=y
CONFIG_PACKAGE_gst1-mod-icydemux=y
CONFIG_PACKAGE_gst1-mod-id3demux=y
CONFIG_PACKAGE_gst1-mod-id3tag=y
CONFIG_PACKAGE_gst1-mod-imagefreeze=y
CONFIG_PACKAGE_gst1-mod-interleave=y
CONFIG_PACKAGE_gst1-mod-isomp4=y
CONFIG_PACKAGE_gst1-mod-jpegformat=y
CONFIG_PACKAGE_gst1-mod-lame=y
CONFIG_PACKAGE_gst1-mod-level=y
CONFIG_PACKAGE_gst1-mod-matroska=y
CONFIG_PACKAGE_gst1-mod-mpeg2dec=y
CONFIG_PACKAGE_gst1-mod-mpegpsdemux=y
CONFIG_PACKAGE_gst1-mod-mpegpsmux=y
CONFIG_PACKAGE_gst1-mod-mulaw=y
CONFIG_PACKAGE_gst1-mod-multifile=y
CONFIG_PACKAGE_gst1-mod-multipart=y
CONFIG_PACKAGE_gst1-mod-mxf=y
CONFIG_PACKAGE_gst1-mod-navigationtest=y
CONFIG_PACKAGE_gst1-mod-ogg=y
CONFIG_PACKAGE_gst1-mod-opus=y
CONFIG_PACKAGE_gst1-mod-opusparse=y
CONFIG_PACKAGE_gst1-mod-oss4=y
CONFIG_PACKAGE_gst1-mod-ossaudio=y
CONFIG_PACKAGE_gst1-mod-pcapparse=y
CONFIG_PACKAGE_gst1-mod-playback=y
CONFIG_PACKAGE_gst1-mod-pnm=y
CONFIG_PACKAGE_gst1-mod-pulse=y
CONFIG_PACKAGE_gst1-mod-replaygain=y
CONFIG_PACKAGE_gst1-mod-rfbsrc=y
CONFIG_PACKAGE_gst1-mod-rtp=y
CONFIG_PACKAGE_gst1-mod-rtpmanager=y
CONFIG_PACKAGE_gst1-mod-rtsp=y
CONFIG_PACKAGE_gst1-mod-sdpelem=y
CONFIG_PACKAGE_gst1-mod-segmentclip=y
CONFIG_PACKAGE_gst1-mod-shapewipe=y
CONFIG_PACKAGE_gst1-mod-shm=y
CONFIG_PACKAGE_gst1-mod-siren=y
CONFIG_PACKAGE_gst1-mod-smpte=y
CONFIG_PACKAGE_gst1-mod-spectrum=y
CONFIG_PACKAGE_gst1-mod-speed=y
CONFIG_PACKAGE_gst1-mod-subenc=y
CONFIG_PACKAGE_gst1-mod-tcp=y
CONFIG_PACKAGE_gst1-mod-theora=y
CONFIG_PACKAGE_gst1-mod-typefindfunctions=y
CONFIG_PACKAGE_gst1-mod-udp=y
CONFIG_PACKAGE_gst1-mod-video4linux2=y
CONFIG_PACKAGE_gst1-mod-videobox=y
CONFIG_PACKAGE_gst1-mod-videoconvert=y
CONFIG_PACKAGE_gst1-mod-videocrop=y
CONFIG_PACKAGE_gst1-mod-videofilter=y
CONFIG_PACKAGE_gst1-mod-videomixer=y
CONFIG_PACKAGE_gst1-mod-videorate=y
CONFIG_PACKAGE_gst1-mod-videoscale=y
CONFIG_PACKAGE_gst1-mod-videotestsrc=y
CONFIG_PACKAGE_gst1-mod-volume=y
CONFIG_PACKAGE_gst1-mod-vorbis=y
CONFIG_PACKAGE_gst1-mod-wavenc=y
CONFIG_PACKAGE_gst1-mod-wavparse=y
CONFIG_PACKAGE_gst1-plugins-bad=y
CONFIG_PACKAGE_gst1-plugins-base=y
CONFIG_PACKAGE_gst1-plugins-good=y
CONFIG_PACKAGE_gst1-plugins-ugly=y
CONFIG_PACKAGE_gstreamer1=y
CONFIG_PACKAGE_gstreamer1-libs=y
CONFIG_PACKAGE_gstreamer1-plugins-bad=y
CONFIG_PACKAGE_gstreamer1-plugins-base=y
CONFIG_PACKAGE_gstreamer1-plugins-good=y
CONFIG_PACKAGE_gstreamer1-plugins-ugly=y
CONFIG_PACKAGE_gstreamer1-utils=y
# CONFIG_PACKAGE_gxcoreapi is not set
# CONFIG_PACKAGE_gxmpd is not set
CONFIG_PACKAGE_htop=y
CONFIG_PACKAGE_httpsession=y
CONFIG_PACKAGE_input-event=y
CONFIG_PACKAGE_iperf=y
CONFIG_PACKAGE_iw=y
CONFIG_PACKAGE_iwinfo=y
# CONFIG_PACKAGE_jansson is not set
CONFIG_PACKAGE_jsoncpp=y
CONFIG_PACKAGE_kmod-bcmdhd=y
CONFIG_PACKAGE_kmod-sound-soc-gx-codec=y
CONFIG_PACKAGE_kmod-sound-soc-nationalchip=y
CONFIG_PACKAGE_kmod-sound-soc-sma1301=y
CONFIG_PACKAGE_lame-lib=y
CONFIG_PACKAGE_libapr=y
CONFIG_PACKAGE_libaprutil=y
CONFIG_PACKAGE_libarchive=y
# CONFIG_PACKAGE_libaudiofile is not set
CONFIG_PACKAGE_libbfd=y
CONFIG_PACKAGE_libconfig=y
# CONFIG_PACKAGE_libdb47 is not set
CONFIG_PACKAGE_libeloop_mini=y
# CONFIG_PACKAGE_libfaad2 is not set
CONFIG_PACKAGE_libffmpeg-audio-dec=y
# CONFIG_PACKAGE_libffmpeg-full is not set
# CONFIG_PACKAGE_libflac is not set
# CONFIG_PACKAGE_libgdbm is not set
CONFIG_PACKAGE_libgmp=y
CONFIG_PACKAGE_libgnutls=y
CONFIG_PACKAGE_libgst1adaptivedemux=y
CONFIG_PACKAGE_libgst1allocators=y
CONFIG_PACKAGE_libgst1app=y
CONFIG_PACKAGE_libgst1audio=y
CONFIG_PACKAGE_libgst1badbase=y
CONFIG_PACKAGE_libgst1basecamerabinsrc=y
CONFIG_PACKAGE_libgst1check=y
CONFIG_PACKAGE_libgst1controller=y
CONFIG_PACKAGE_libgst1fft=y
CONFIG_PACKAGE_libgst1net=y
CONFIG_PACKAGE_libgst1pbutils=y
CONFIG_PACKAGE_libgst1photography=y
CONFIG_PACKAGE_libgst1riff=y
CONFIG_PACKAGE_libgst1rtp=y
CONFIG_PACKAGE_libgst1rtsp=y
CONFIG_PACKAGE_libgst1sdp=y
CONFIG_PACKAGE_libgst1tag=y
CONFIG_PACKAGE_libgst1uridownloader=y
CONFIG_PACKAGE_libgst1video=y
CONFIG_PACKAGE_libgstreamer1=y
# CONFIG_PACKAGE_libid3tag is not set
CONFIG_PACKAGE_libiwinfo=y
CONFIG_PACKAGE_liblzma=y
# CONFIG_PACKAGE_libmad is not set
# CONFIG_PACKAGE_libmms is not set
# CONFIG_PACKAGE_libmpdclient is not set
CONFIG_PACKAGE_libmpeg2=y
CONFIG_PACKAGE_libnettle=y
CONFIG_PACKAGE_liboil=y
CONFIG_PACKAGE_libopus=y
CONFIG_PACKAGE_libpcre=y
CONFIG_PACKAGE_librplayer=y
CONFIG_PACKAGE_libsoup=y
CONFIG_PACKAGE_libssp=y
CONFIG_PACKAGE_libtheora=y
CONFIG_PACKAGE_libthread-db=y
CONFIG_PACKAGE_libubootenv=y
# CONFIG_PACKAGE_libupnp is not set
CONFIG_PACKAGE_libusb-1.0=y
CONFIG_PACKAGE_libuuid=y
CONFIG_PACKAGE_libuv=y
CONFIG_PACKAGE_libv4l=y
# CONFIG_PACKAGE_libvorbisidec is not set
CONFIG_PACKAGE_lightservice=y
CONFIG_PACKAGE_lumenlight=y
# CONFIG_PACKAGE_mpc is not set
CONFIG_PACKAGE_mutils=y
CONFIG_PACKAGE_net_manager=y
CONFIG_PACKAGE_openfst=y
# CONFIG_PACKAGE_openmaxIL is not set
CONFIG_PACKAGE_ota_unpack=y
# CONFIG_PACKAGE_poco-1.7.8p2-all is not set
CONFIG_PACKAGE_procps-ng=y
CONFIG_PACKAGE_procps-ng-free=y
CONFIG_PACKAGE_procps-ng-kill=y
CONFIG_PACKAGE_procps-ng-pgrep=y
CONFIG_PACKAGE_procps-ng-pkill=y
CONFIG_PACKAGE_procps-ng-pmap=y
CONFIG_PACKAGE_procps-ng-ps=y
CONFIG_PACKAGE_procps-ng-pwdx=y
CONFIG_PACKAGE_procps-ng-skill=y
CONFIG_PACKAGE_procps-ng-slabtop=y
CONFIG_PACKAGE_procps-ng-snice=y
CONFIG_PACKAGE_procps-ng-tload=y
CONFIG_PACKAGE_procps-ng-top=y
CONFIG_PACKAGE_procps-ng-uptime=y
CONFIG_PACKAGE_procps-ng-vmstat=y
CONFIG_PACKAGE_procps-ng-w=y
CONFIG_PACKAGE_procps-ng-watch=y
CONFIG_PACKAGE_property=y
CONFIG_PACKAGE_property_service=y
# CONFIG_PACKAGE_protobuf is not set
CONFIG_PACKAGE_pstore=y
CONFIG_PACKAGE_pulseaudio-profiles=y
CONFIG_PACKAGE_pulseaudio-tools=y
# CONFIG_PACKAGE_python is not set
# CONFIG_PACKAGE_python-base is not set
# CONFIG_PACKAGE_python-codecs is not set
# CONFIG_PACKAGE_python-compiler is not set
# CONFIG_PACKAGE_python-ctypes is not set
# CONFIG_PACKAGE_python-db is not set
# CONFIG_PACKAGE_python-decimal is not set
# CONFIG_PACKAGE_python-distutils is not set
# CONFIG_PACKAGE_python-email is not set
# CONFIG_PACKAGE_python-gdbm is not set
# CONFIG_PACKAGE_python-light is not set
# CONFIG_PACKAGE_python-logging is not set
# CONFIG_PACKAGE_python-multiprocessing is not set
# CONFIG_PACKAGE_python-ncurses is not set
# CONFIG_PACKAGE_python-openssl is not set
# CONFIG_PACKAGE_python-pydoc is not set
# CONFIG_PACKAGE_python-sqlite3 is not set
# CONFIG_PACKAGE_python-unittest is not set
# CONFIG_PACKAGE_python-xml is not set
CONFIG_PACKAGE_rkamsex=y
CONFIG_PACKAGE_rklog=y
# CONFIG_PACKAGE_screen is not set
# CONFIG_PACKAGE_senseflow is not set
CONFIG_PACKAGE_speech=y
# CONFIG_PACKAGE_sptk-3.9 is not set
CONFIG_PACKAGE_tinyalsa=y
CONFIG_PACKAGE_uWS=y
CONFIG_PACKAGE_uboot-leo-k18-universal=y
CONFIG_PACKAGE_uclibcxx=y
CONFIG_PACKAGE_vol_ctrl=y
CONFIG_PACKAGE_wget=y
CONFIG_PACKAGE_wifi_monitor=y
CONFIG_PACKAGE_wireless-tools=y
CONFIG_PACKAGE_wpa-cli=y
CONFIG_PACKAGE_wpa-supplicant=y
CONFIG_PACKAGE_wpa_ctrl=y
CONFIG_PACKAGE_yimo=y
CONFIG_PACKAGE_zeromq=y
CONFIG_PACKAGE_zlib-dev=y
CONFIG_PACKAGE_zoneinfo-asia=y
CONFIG_PACKAGE_zoneinfo-core=y
CONFIG_PRODUCT_PATHNAME="rokid/universal"
CONFIG_SSP_SUPPORT=y
CONFIG_STRIP_ARGS="--strip-all"
CONFIG_TARGET_APP_UBIFS=y
CONFIG_TARGET_EXT4_MAXINODE=7000
CONFIG_TARGET_EXT4_RESERVED_PCT=1
CONFIG_TARGET_ROOTFS_SQUASHFS=y
CONFIG_TARGET_SQUASHFS_BLOCK_SIZE=32
CONFIG_TARGET_SUFFIX="gnueabi"
CONFIG_TARGET_UBIFS_COMPRESSION_XZ=y
# CONFIG_TARGET_UBIFS_COMPRESSION_ZLIB is not set
# CONFIG_TARGET_UBIFS_FREE_SPACE_FIXUP is not set
CONFIG_USE_GLIBC=y
CONFIG_USE_STRIP=y
CONFIG_VSP_DEFCONFIG="k18_universal_defconfig"
CONFIG_WIFI_BT_AMPAK=y
CONFIG_WPA_SUPPLICANT_INTERNAL=y
CONFIG_YIMO_ENABLE_LIB_INPUT_EVENT=y
CONFIG_YIMO_HARDWARE="k18"
CONFIG_YIMO_TARGET_AVS=y
CONFIG_YIMO_TARGET_OTA=y
CONFIG_PACKAGE_bash=y
CONFIG_PACKAGE_boost=y
# CONFIG_PACKAGE_boost-atomic is not set
# CONFIG_PACKAGE_boost-chrono is not set
CONFIG_PACKAGE_boost-container=y
# CONFIG_PACKAGE_boost-context is not set
# CONFIG_PACKAGE_boost-coroutine is not set
# CONFIG_PACKAGE_boost-date_time is not set
# CONFIG_PACKAGE_boost-fiber is not set
# CONFIG_PACKAGE_boost-filesystem is not set
# CONFIG_PACKAGE_boost-graph is not set
# CONFIG_PACKAGE_boost-iostreams is not set
# CONFIG_PACKAGE_boost-log is not set
# CONFIG_PACKAGE_boost-math is not set
# CONFIG_PACKAGE_boost-program_options is not set
# CONFIG_PACKAGE_boost-random is not set
# CONFIG_PACKAGE_boost-regex is not set
# CONFIG_PACKAGE_boost-serialization is not set
# CONFIG_PACKAGE_boost-signals is not set
# CONFIG_PACKAGE_boost-system is not set
# CONFIG_PACKAGE_boost-thread is not set
# CONFIG_PACKAGE_boost-timer is not set
# CONFIG_PACKAGE_boost-wave is not set
CONFIG_PACKAGE_libreadline=y
CONFIG_PACKAGE_vsp=y
# CONFIG_USE_LIBSTDCXX is not set
CONFIG_USE_UCLIBCXX=y
CONFIG_VSP_DEFCONFIG="k18_universal_defconfig"
# CONFIG_YIMO_TARGET_DEMO is not set
# CONFIG_boost-coroutine2 is not set
# CONFIG_boost-graph-parallel is not set
# CONFIG_boost-libs-all is not set
CONFIG_boost-runtime-shared=y
# CONFIG_boost-shared-libs is not set
CONFIG_boost-static-and-shared-libs=y
# CONFIG_boost-static-libs is not set
# CONFIG_boost-test-pkg is not set
# CONFIG_boost-use-name-tags is not set
# CONFIG_boost-variant-debug is not set
# CONFIG_boost-variant-profile is not set
CONFIG_boost-variant-release=y
```
